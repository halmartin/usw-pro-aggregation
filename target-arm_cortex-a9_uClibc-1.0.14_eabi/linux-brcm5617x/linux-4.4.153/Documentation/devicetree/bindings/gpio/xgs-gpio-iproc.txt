## target-arm_cortex-a9_uClibc-1.0.14_eabi/linux-brcm5617x/linux-4.4.153/Documentation/devicetree/bindings/gpio/xgs-gpio-iproc.txt
```
Broadcom XGS iProc GPIO Controller

Required properties:
- compatible : Should be "brcm,iproc-gpio,cca" or "brcm,iproc-gpio,ccg".
 	"brcm,iproc-gpio,cca" is used for CCA type gpio controllers on Helix4/Katana2/HR2. 
	"brcm,iproc-gpio,ccg" is used for CCG type gpio controllers on Grehound/Saber2/HR3/Greyhound2.
- reg : Physical base address and length of the controller's registers.
- #gpio-cells : should be 2
- ngpios : The number of GPIO's the controller provides.
- interrupts : The interrupt id for the controller.
- pin-base : The first chip GPIO pin provided by CCA or CCG. For Helix4, set to 4.
- pin-offset : The offset of available CCA or CCG GPIO pins. For Helix4, set to 0.
- gpio-controller : Marks the device node as a GPIO controller.

Optional properties:
- interrupt-controller : Marks the device node as an interrupt controller.


Examples for cca gpio:

  gpio_cca: gpio@18000060 {
		compatible = "brcm,iproc-gpio,cca";
		#gpio-cells = <2>;
		reg = gpio: <0x18000060 0x50>,
		     		intr: <0x18000000 0x50>;
		ngpios = <8>;
		pin-offset = <0>;
		pin-base = <4>;
		gpio-controller;
		interrupt-controller;
		interrupts = <GIC_SPI 91 IRQ_TYPE_LEVEL_HIGH>;
	};

  gpio_ccg: gpio@1800a000 {
		compatible = "brcm,iproc-gpio,ccg";
		#gpio-cells = <2>;
		reg = gpio: <0x1800a000 0x50>;
		ngpios = <12>;
		pin-offset = <4>;
		pin-base = <4>;
		gpio-controller;
		interrupt-controller;
		interrupts = <GIC_SPI 64 IRQ_TYPE_LEVEL_HIGH>;
	};

	
```

## target-arm_cortex-a9_uClibc-1.0.14_eabi/linux-brcm5617x/linux-4.4.153/Documentation/devicetree/bindings/net/xgs-iproc-mdio.txt
```
* Broadcom XGS iProc MDIO bus controller

Required properties:
- compatible: should be "brcm,iproc-ccb-mdio" or "brcm,iproc-ccg-mdio" or "brcm,iproc-cmicd-mdio"
- reg: address and length of the register set for the MDIO interface
- #size-cells: must be 0
- #address-cells: must be 1
- #bus-id: Physical bus ID
- #logical-bus-id: Logical bus ID, required for cmicd
- bus-type: "internal" or "external"
- clocks: clock source

Example:

	mdio_int: mdio_int@18002000 {
		compatible = "brcm,iproc-ccg-mdio";
		reg = <0x18002000 0x1000>;
		#bus-id = <0>;
		bus-type = "internal";
		clocks = <&iproc_apb_clk>;
	};
	
	mdio_ext: mdio_ext@03210000 {
		compatible = "brcm,iproc-cmicd-mdio";
		reg = <0x03210000 0x1000>;
		#bus-id = <2>;
		#logical-bus-id = <0>;
		bus-type = "external";
		clocks = <&iproc_apb_clk>;
	};
```

## target-arm_cortex-a9_uClibc-1.0.14_eabi/linux-brcm5617x/linux-4.4.153/Documentation/devicetree/bindings/pci/xgs-iproc-pcie.txt
```
* Broadcom XGS iProc PCIe controller

Required properties:
- compatible: set to "brcm,iproc-pcie"
- reg: base address and length of the PCIe controller
- linux,pci-domain: PCI domain ID. Should be unique for each host controller
- interrupts: interrupt ID
- #address-cells: set to <3>
- #size-cells: set to <2>
- device_type: set to "pci"
- ranges: ranges for the PCI memory and I/O regions

Optional properties:
- phy-addr: PCIe PHY addr for MDIO access
- bus-range: PCI bus numbers covered

Example:

  pcie0: pcie@18012000 {
		compatible = "brcm,iproc-pcie";
		reg = <0x18012000 0x1000>;
		linux,pci-domain = <0>;
		interrupts = <GIC_SPI 75 IRQ_TYPE_LEVEL_HIGH>,
			     <GIC_SPI 76 IRQ_TYPE_LEVEL_HIGH>,
			     <GIC_SPI 77 IRQ_TYPE_LEVEL_HIGH>,
			     <GIC_SPI 78 IRQ_TYPE_LEVEL_HIGH>,
			     <GIC_SPI 79 IRQ_TYPE_LEVEL_HIGH>,
			     <GIC_SPI 80 IRQ_TYPE_LEVEL_HIGH>; 
		#address-cells = <3>;
		#size-cells = <2>;
		device_type = "pci";	
		ranges = <0x82000000 0 0x20000000 0x20000000 0 0x20000000>;	
		phy-addr = <0>;
	};
	
```

## target-arm_cortex-a9_uClibc-1.0.14_eabi/linux-brcm5617x/linux-4.4.153/Documentation/devicetree/bindings/spi/xgs-iproc-qspi.txt
```
BROADCOM XGS iProc QSPI controller

Required properties:
- compatible: "brcm,iproc-qspi";
- reg: Offset and length of the register set including 
		mspi_hw: Master SPI
		bspi_hw: Boot SPI
		bspi_hw_raf: Boot SPI read ahead fifo
		qspi_intr: QSPI interrupt related
		idm_qspi:QSPI IDM related
		cru_hw: QSPI CRU related
- interrupts: interrupt id of the QSPI controller		
- clocks: clock source

Optional properties:
- #chip-select: Specify the used chip select for controller with multi chip selects

Example:

  qspi: spi@18047000 {
			#address-cells = <1>;
			#size-cells = <0>;
			compatible = "brcm,iproc-qspi";
			reg = mspi_hw:<0x18047200 0x188>,
		      		bspi_hw:<0x18047000 0x050>,
		  		bspi_hw_raf:<0x18047100 0x024>,
		    		qspi_intr:<0x180473a0 0x01c>,
		     		idm_qspi:<0x1811f408 0x004>,
		      		cru_hw:<0x1800e000 0x004>;
			interrupts = <GIC_SPI 58 IRQ_TYPE_LEVEL_HIGH>;
			#chip-select = <0>; 
			clocks = <&iproc_apb_clk>;
		};
		
```

## target-arm_cortex-a9_uClibc-1.0.14_eabi/linux-brcm5617x/linux-4.4.153/arch/arm/boot/dts/ubnt-usxg-sign.its
```
/dts-v1/;

/ {
	description = "Linux kernel and FDT blob";
	#address-cells = <1>;
	
	images {
		kernel@1 {
			description = "Broadcom iProc Linux";
			data = /incbin/("../Image");
			type = "kernel";
			arch = "arm";
			os = "linux";
			compression = "none";
			load = <0x61008000>;
			entry = <0x61008000>;
			hash@1 {
				algo = "crc32";
			};
			signature {
				required = "image";
				algo = "sha1,rsa2048";
				key-name-hint = "us_bcm5xxxx_64m";
			};
		};
		
		fdt@1 {
			description = "Flattened Device Tree blob - bcm956170.dtb";
			data = /incbin/("./ubnt-usxg-24-poe.dtb");
			type = "flat_dt";
			arch = "arm";
			compression = "none";
			hash@1 {
				algo = "crc32";
			};
		};

	};	
	
	configurations {
		default = "conf@1";
		conf@1 {
			description = "USW-XG configuration";
			kernel = "kernel@1";
			fdt = "fdt@1";
			signature {
				required = "image";
				algo = "sha1,rsa2048";
				key-name-hint = "us_bcm5xxxx_64m";
				sign-images = "fdt", "kernel";
            };
		};
	};
};
```

## target-arm_cortex-a9_uClibc-1.0.14_eabi/linux-brcm5617x/linux-4.4.153/arch/arm/mach-iproc/Kconfig
```kconfig
menuconfig ARCH_XGS_IPROC
	bool "Broadcom XGS iProc Support" if ARCH_MULTI_V7
	select HAVE_ARM_TWD if SMP
	select HAVE_ARM_SCU if SMP
	select ARM_GLOBAL_TIMER
	select ARM_GIC
	select ARCH_REQUIRE_GPIOLIB
	select CACHE_L2X0
	select ARM_AMBA
	select ARCH_SUPPORTS_BIG_ENDIAN
        select CPU_ENDIAN_BE8 if CPU_BIG_ENDIAN
        select ARM_ERRATA_754322
	select ARM_ERRATA_764369 if SMP
	select ARM_ERRATA_775420
	help
	  This enables support for Broadcom XGS iProc based SoC chips

if ARCH_XGS_IPROC

comment	"XGS iProc SoC based Machine types"	

choice
	prompt "XGS iProc SoC based Machine types"
	default MACH_HX4

config MACH_HX4
	bool "Support Broadcom Helix4 bring-up board"
	help
	  Support for the Broadcom Helix4 bring-up board.

config MACH_HR2
	bool "Support Broadcom Hurricane2 bring-up board"
	help
	  Support for the Broadcom Hurricane2 bring-up board.

config MACH_KT2
	bool "Support Broadcom Katana2 bring-up board"
	help
	  Support for the Broadcom Katana2 bring-up board.

config MACH_GH
	bool "Support Broadcom Greyhound bring-up board"
	select MACH_IPROC_P7
	help
	  Support for the Broadcom Greyhound bring-up board.

config MACH_SB2
	bool "Support Broadcom Saber2 bring-up board"
	select MACH_IPROC_P7
	help
	  Support for the Broadcom Saber2 bring-up board.

config MACH_HR3
	bool "Support Broadcom Hurricane3 bring-up board"
	select MACH_IPROC_P7
	help
	  Support for the Broadcom Hurricane3 bring-up board.

config MACH_GH2
       bool "Support Broadcom Greyhound2 bring-up board"
       select MACH_IPROC_P7
       help
         Support for the Broadcom Greyhound2 bring-up board.
endchoice

config MACH_IPROC_P7
	bool "Support iProc Profile 7 architecture"
	depends on (MACH_GH || MACH_SB2 || MACH_HR3 || MACH_GH2 || MACH_WH2)
	help
	  Support for iProc Profile 7 architecture.

config MACH_WH2
  bool "Support Broadcom Wolfhound2 bring-up board"
	depends on MACH_HR3
	default n
	help
	  Support for the Broadcom Wolfhound2 bring-up board.

config MACH_IPROC_EMULATION
	bool "Support iProc emulation"
	help
	  Support for the iProc emulation.

endif
```

## target-arm_cortex-a9_uClibc-1.0.14_eabi/linux-brcm5617x/linux-4.4.153/drivers/soc/bcm/Kconfig
```kconfig
menuconfig SOC_XGS_IPROC
	bool "Broadcom XGS iProc IDM/DMU/PMU drivers"
	depends on ARCH_XGS_IPROC
	default ARCH_XGS_IPROC
	help
	  This option enables XGS iProc IDM/DMU/PMU related drivers.

	  If unsure, say Y.
```
